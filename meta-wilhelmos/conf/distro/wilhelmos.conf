## meta-wilhelmos/conf/distro/wilhelmos.conf
```bitbake
# meta-wilhelmos/conf/distro/wilhelmos.conf

# Start from Poky defaults
require conf/distro/poky.conf

# Distro identity
DISTRO = "wilhelmos"
DISTRO_NAME = "WilhelmOS"
DISTRO_VERSION = "0.1.0"
DISTRO_CODENAME = "experimental"

# Features / platform policy
DISTRO_FEATURES:append = " efi"

# WilhelmOS is Wayland-only: opt out of the x11 default feature so no GLX/X11
# code paths exist in the image (restriction of functionality, ED-109A
# 12.4.11). The kiosk stack is cage/wlroots + EGL.
DISTRO_FEATURES_OPTED_OUT:append = " x11"

# GLVND provides the vendor-neutral libEGL/libOpenGL dispatch libraries that
# runtime GL loaders (e.g. Dear ImGui's) expect on a GLX-less system.
DISTRO_FEATURES:append = " glvnd"

# Init: systemd only. Pulls init-manager-systemd.inc, which appends the
# systemd and usrmerge DISTRO_FEATURES and sets the VIRTUAL-RUNTIME init
# providers (poky defaults to sysvinit).
INIT_MANAGER = "systemd"

# Bootloader / EFI
EFI_PROVIDER = "systemd-boot"
# Rollback to grub by uncommenting below.
#EFI_PROVIDER = "grub-efi"
#GRUB_DEPLOY = "1"

# BusyBox syslog/klogd are disabled in recipes-core/busybox/busybox_%.bbappend
# so that journald is the only logging path.
VIRTUAL-RUNTIME_syslog = "systemd"

# Users
INHERIT += "extrausers"

# - Lock root password
# - Create user "wilhelmos" with preset password hash
# - Add to wheel group
# - password hash was created with openssl passwd -6 'wilhelmos’
EXTRA_USERS_PARAMS = "\
    usermod -p '!' root; \
    useradd -m -s /bin/sh wilhelmos; \
    usermod -p '\$6\$c2xI25/4xvQ.UJf0\$GXxGRh8lgtTjkYXbxOJ8m4R1K7hwDTry0ixJ2kTMPoyI3ycFTrpmfXgPmFHT6XfBghzsz6YFwplmuPFUD918E0' wilhelmos; \
    usermod -a -G wheel wilhelmos; \
"

# --- ED-109A Section 7: configuration management / reproducibility evidence ---

# SBOM: SPDX documents per package + image-level archive in tmp/deploy/images/
INHERIT += "create-spdx"
SPDX_PRETTY = "1"

# Binary reproducibility is default-on since honister; assert it explicitly so
# the policy is visible and survives upstream default changes.
BUILD_REPRODUCIBLE_BINARIES = "1"

# Package/image manifest history for regression evidence (build-host artifact,
# committed to a git repo under ${TOPDIR}/buildhistory).
INHERIT += "buildhistory"
BUILDHISTORY_COMMIT = "1"

# --- Persistent logging ---
# /var/log must be real storage, not a volatile symlink, or journald's
# Storage=persistent (see wilhelmos-journald-conf) is a no-op. Since
# Yocto 5.x this is controlled via the fs-perms tables (VOLATILE_LOG_DIR
# is obsolete).
FILESYSTEM_PERMS_TABLES:remove = "files/fs-perms-volatile-log.txt"
```

## meta-wilhelmos/wic/wilhelmos-efi-debug.wks
```
# WilhelmOS UEFI-bootable GPT disk image — debug variant.
# Same layout as wilhelmos-efi.wks but with verbose console/systemd boot
# logging on the kernel cmdline. Intended for dd-to-USB bare-metal
# debugging; runqemu constructs its own cmdline and mostly ignores this.
# Select via: kas build kas/qemu-kirkstone.yaml:kas/debug.yaml

part /boot --source bootimg-efi --sourceparams="loader=systemd-boot" --label boot --active --align 4096

part / --source rootfs --fstype=ext4 --label rootfs --align 4096

bootloader --ptable=gpt --timeout=3 --append="root=PARTLABEL=rootfs rootwait console=tty0 console=ttyS0,115200 systemd.log_target=console systemd.log_level=info systemd.show_status=1 loglevel=7"
```

## meta-wilhelmos/wic/wilhelmos-efi.wks
```
# UEFI-bootable GPT disk image for generic x86-64

# EFI System Partition with GRUB-EFI
# Rollback to grub by commenting/uncommenting below
# part /boot --source bootimg-efi --sourceparams="loader=grub-efi" --label boot --active --align 4096
part /boot --source bootimg-efi --sourceparams="loader=systemd-boot" --label boot --active --align 4096

# Root filesystem
part / --source rootfs --fstype=ext4 --label rootfs --align 4096

# GPT partition table, BIOS/UEFI handled via bootimg-efi
bootloader --ptable=gpt --timeout=3 --append="root=PARTLABEL=rootfs rootwait"
# use for qemu
# bootloader --ptable=gpt --timeout=3 --append="console=tty0 console=ttyS0,115200 systemd.log_target=console systemd.log_level=info systemd.show_status=1 quiet=0 loglevel=7"
```
